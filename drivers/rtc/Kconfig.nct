## drivers/rtc/Kconfig.nct
```kconfig
# NCT RTC Driver configuration options

# Copyright (c) 2024 Nuvoton Technology Corporation.
# SPDX-License-Identifier: Apache-2.0

config RTC_NCT
	bool "Nuvoton NCT RTC driver"
	depends on DT_HAS_NUVOTON_NCT_RTC_ENABLED
	depends on DT_HAS_NUVOTON_NCT_C2H_ENABLED
	select C2H_NCT
	help
	  This option enables the RTC driver for Nuvoton NCT family of
	  processors. The RTC accesses registers through C2H, so the C2H
	  devicetree node must be enabled.
	  Say y if you wish to enable NCT RTC.
```

## dts/bindings/tach/nuvoton,nct-tach.yaml
```yaml
# Copyright (c) 2025 Nuvoton Technology Corporation.
# SPDX-License-Identifier: Apache-2.0

description: Nuvoton NCT Multi-Function Timer (MFT) controller

compatible: "nuvoton,nct-tach"

include: [base.yaml, pinctrl-device.yaml]

properties:
  reg:
    required: true
  clocks:
    required: true
  tach-channel:
    type: int
    description: |
      Index of the MFT hardware module (1, 2, or 3).
      Do not override in board-level device trees.
  pin-select:
    type: int
    description: TA pin index routed to this tachometer input.
  pin-static:
    type: boolean
    description: Tachometer pin is fixed and cannot be selected.
  sample-clk:
    type: int
    description: Tachometer sampling clock selection.
  pulses-per-round:
    type: int
    description: Encoder pulses per revolution.
```
