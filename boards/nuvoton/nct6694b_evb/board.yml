## boards/nuvoton/nct6694b_evb/board.yml
```yaml
board:
  name: nct6694b_evb
  full_name: NCT6694B_EVB
  vendor: nuvoton
  socs:
  - name: nct6694b
```

## boards/nuvoton/nct6832d_mdb/board.yml
```yaml
board:
  name: nct6832d_mdb
  full_name: NCT6832D_MDB
  vendor: nuvoton
  socs:
  - name: nct6832d
```

## drivers/sensor/nuvoton/nuvoton_tach_nct/Kconfig
```kconfig
# NCT tachometer sensor configuration options

# Copyright (c) 2024 Nuvoton Technology Corporation.
# SPDX-License-Identifier: Apache-2.0

config TACH_NCT
	bool "Nuvoton NCT MFT controller"
	default y
	depends on DT_HAS_NUVOTON_NCT_TACH_ENABLED
	depends on SOC_FAMILY_NCT
	help
	  Enable the Nuvoton NCT Multi-Function Timer (MFT) controller driver.
	  This driver initialises the MFT hardware and exposes it as a
	  non-sensor device for use by tach-input child nodes.

config TACH_NCT_INPUT
	bool "Nuvoton NCT Tachometer input sensor"
	default y
	depends on DT_HAS_NUVOTON_NCT_TACH_INPUT_ENABLED
	depends on TACH_NCT
	depends on SOC_FAMILY_NCT
	help
	  Enable the Nuvoton NCT virtual tachometer-input sensor driver.
	  Each enabled nuvoton,nct-tach-input DT node creates one sensor
	  device that measures fan RPM on a single TA pin, sharing the
	  parent MFT hardware via a spinlock.
```

## drivers/usb/udc/Kconfig.nct
```kconfig
# Copyright (c) 2025 Nuvoton Technology Corporation.
# SPDX-License-Identifier: Apache-2.0

config UDC_NCT
	bool "Nuvoton NCT USB Device Controller Driver"
	default y
	depends on DT_HAS_NUVOTON_NCT_USBD_ENABLED && USB_DEVICE_STACK_NEXT
	help
	  This option enables the USB device driver for NCT family of processors.
	  Say y if you wish to use USB device on NCT.

config UDC_NCT_THREAD_STACK_SIZE
	int "UDC NCT USB device controller driver internal thread stack size"
	depends on UDC_NCT
	default 512
	help
	  USB device controller driver internal thread stack size.
```

## dts/bindings/misc/nuvoton,nct-flm.yaml
```yaml
# Copyright (c) 2026 Nuvoton Technology Corporation.
# SPDX-License-Identifier: Apache-2.0

description: Nuvoton, NCT Flash Monitoring Core (FLM) node

compatible: "nuvoton,nct-flm"

include: [base.yaml]

properties:
  reg:
    required: true

  interrupts:
    required: true
```

## dts/bindings/tach/nuvoton,nct-tach-input.yaml
```yaml
# Copyright (c) 2025 Nuvoton Technology Corporation.
# SPDX-License-Identifier: Apache-2.0

description: >
  Nuvoton NCT tachometer input - a virtual sensor backed by an MFT controller.
  Multiple tach-input nodes may reference the same MFT instance; the driver
  time-multiplexes them via a spinlock (non-blocking).

compatible: "nuvoton,nct-tach-input"

include: [sensor-device.yaml, pinctrl-device.yaml]

properties:
  mft:
    type: phandle
    required: true
    description: >
      Phandle to the MFT controller node (compatible "nuvoton,nct-tach") that
      drives this tachometer input.  Multiple tach-input nodes may share the
      same MFT; each references it here.

  pin-select:
    type: int
    required: true
    description: >
      TA pin index (0-9) routed to this tachometer input.  Use the
      NCT_TACH_PIN_SELECT_* constants from
      <zephyr/dt-bindings/sensor/nct_tach.h>.

  sample-clk:
    type: int
    required: true
    description: >
      Desired sampling clock frequency in Hz.  When the parent MFT is sourced
      from LFCLK (NCT_CLOCK_MFTx_LF), this must be 32768.  For APB-sourced
      MFTs the prescaler is calculated automatically.

  pulses-per-round:
    type: int
    required: true
    description: Number of encoder pulses per shaft revolution.

  pinctrl-0:
    required: true

  pinctrl-names:
    required: true
```

## dts/bindings/tach/nuvoton,nct-tach.yaml
```yaml
# Copyright (c) 2025 Nuvoton Technology Corporation.
# SPDX-License-Identifier: Apache-2.0

description: Nuvoton NCT Multi-Function Timer (MFT) controller

compatible: "nuvoton,nct-tach"

include: base.yaml

properties:
  reg:
    required: true
  clocks:
    required: true
  tach-channel:
    type: int
    description: |
      Index of the MFT hardware module (1, 2, or 3).
      Do not override in board-level device trees.
```
